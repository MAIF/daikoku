## daikoku/conf/local.conf
```bitbake
include "base.conf"

daikoku {
  flags {
    multiPlanSubscriptionEnabled = true
  }

  mode = "dev"
  signingKey = "secret"
  storage = "postgres"
  exposedOn= 5173

  health {
    accessKey = "secret"
  }

  otoroshi {
    sync {
      cron = true
    }
  }

  notificationsPurgeJob {
    enabled = true
    interval = 1hour
    mode = "interval"
    key = "secret"
    max.to.treat.date = 1days
    max.base.date = 1days
  }

  auditTrailPurgeJob {
    enabled = true
    interval = 1hour
    mode = "interval"
    key = "secret"
    max.date = 10minutes
  }

  remoteCatalogJob {
    enabled = false
    interval = 60000
    mode = "interval"
    key = "secret"
  }

  postgres {
    database = "daikoku"
  }


  tenants {
    provider = "hostname"
  }
}
```
